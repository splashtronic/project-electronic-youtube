/*
 * Birthday Blow Surprise - Arduino Nano
 * Library: Adafruit SSD1306 + Adafruit GFX
 *
 * Wiring:
 *  OLED SSD1306 (I2C)  : SDA->A4, SCL->A5, VCC->5V/3V3, GND
 *  Sensor suara (DO)   : D2
 *  LED (+resistor 220R): D4 -> LED -> GND
 *  Buzzer passive      : D9 -> buzzer -> GND
 *  ISD1820 PLAYL       : D7   (VCC 5V, GND bersama)
 */
#include <Wire.h>
#include <Adafruit_GFX.h>
#include <Adafruit_SSD1306.h>

#define SCREEN_W 128
#define SCREEN_H 64
#define OLED_ADDR 0x3C

const uint8_t PIN_SENSOR = 2;
const uint8_t PIN_LED    = 4;
const uint8_t PIN_BUZZER = 9;
const uint8_t PIN_ISD    = 7;

const unsigned long BLOW_TARGET_MS = 1500;  // minimal tiupan
const unsigned long BLOW_GAP_MS    = 350;   // toleransi sinyal putus-putus
const unsigned long ISD_PLAY_MS    = 6000;  // lama rekaman ISD1820 (sesuaikan)

Adafruit_SSD1306 display(SCREEN_W, SCREEN_H, &Wire, -1);

// ---------- Gambar kejutan 128x64 ----------
const unsigned char surprise_bmp[] PROGMEM = {
  0x00, 0x00, 0x00, 0x00, 0x00, 0x00, 0x00, 0x00, 0x00, 0x00, 0x00, 0x00, 0x00, 0x00, 0x00, 0x00,
  0x00, 0x00, 0x00, 0x00, 0x00, 0x00, 0x00, 0x75, 0x5E, 0x00, 0x00, 0x00, 0x00, 0x00, 0x00, 0x00,
  0x00, 0x00, 0x00, 0x00, 0x00, 0x00, 0x00, 0x40, 0x03, 0x00, 0x00, 0x00, 0x00, 0x00, 0x00, 0x00,
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  0x00, 0x00, 0x00, 0x00, 0x00, 0x00, 0x00, 0x00, 0x00, 0x00, 0x00, 0x00, 0x00, 0x00, 0x00, 0x00
};

// ---------- Lagu Happy Birthday ----------
// durasi dalam satuan 1/16 beat
#define NOTE_C4 262
#define NOTE_D4 294
#define NOTE_E4 330
#define NOTE_F4 349
#define NOTE_G4 392
#define NOTE_A4 440
#define NOTE_B4 494
#define NOTE_C5 523
#define NOTE_D5 587
#define NOTE_E5 659
#define NOTE_F5 698
#define NOTE_G5 784

const uint16_t melody[] PROGMEM = {
  NOTE_G4, NOTE_G4, NOTE_A4, NOTE_G4, NOTE_C5, NOTE_B4,
  NOTE_G4, NOTE_G4, NOTE_A4, NOTE_G4, NOTE_D5, NOTE_C5,
  NOTE_G4, NOTE_G4, NOTE_G5, NOTE_E5, NOTE_C5, NOTE_B4, NOTE_A4,
  NOTE_F5, NOTE_F5, NOTE_E5, NOTE_C5, NOTE_D5, NOTE_C5
};
const uint8_t beats[] PROGMEM = {
  3, 1, 4, 4, 4, 8,
  3, 1, 4, 4, 4, 8,
  3, 1, 4, 4, 4, 4, 8,
  3, 1, 4, 4, 4, 8
};
const uint8_t NOTE_COUNT = sizeof(beats);
const uint8_t UNIT_MS = 120;  // makin kecil = makin cepat

// ---------- Confetti ----------
const uint8_t N_CONF = 28;
int16_t cx[N_CONF], cy[N_CONF];
uint8_t cv[N_CONF];

void initConfetti() {
  for (uint8_t i = 0; i < N_CONF; i++) {
    cx[i] = random(0, SCREEN_W);
    cy[i] = random(-SCREEN_H, 0);
    cv[i] = random(1, 4);
  }
}

void drawConfettiFrame() {
  display.clearDisplay();
  display.setTextColor(SSD1306_WHITE);
  display.setTextSize(2);
  display.setCursor(34, 14);  display.print(F("HAPPY"));
  display.setCursor(16, 34);  display.print(F("BIRTHDAY"));
  for (uint8_t i = 0; i < N_CONF; i++) {
    if (i % 3 == 0)      display.fillRect(cx[i], cy[i], 3, 3, SSD1306_WHITE);
    else if (i % 3 == 1) display.drawPixel(cx[i], cy[i], SSD1306_WHITE),
                         display.drawPixel(cx[i] + 1, cy[i] + 1, SSD1306_WHITE);
    else                 display.drawRect(cx[i], cy[i], 3, 2, SSD1306_WHITE);
    cy[i] += cv[i];
    cx[i] += (int8_t)random(-1, 2);
    if (cy[i] > SCREEN_H) { cy[i] = -3; cx[i] = random(0, SCREEN_W); }
  }
  display.display();
}

// ---------- Scene ----------
void drawFlame(int x, int y) {
  int f = random(-1, 2);
  display.fillCircle(x, y, 3, SSD1306_WHITE);
  display.fillTriangle(x - 3, y - 1, x + 3, y - 1, x + f, y - 9, SSD1306_WHITE);
}

void drawScene(uint8_t phase, uint8_t progress) {
  display.clearDisplay();
  display.setTextColor(SSD1306_WHITE);
  if (phase == 1) {
    // kue
    display.drawRect(20, 50, 88, 13, SSD1306_WHITE);
    display.drawRect(34, 38, 60, 12, SSD1306_WHITE);
    for (uint8_t x = 36; x < 94; x += 6) display.drawFastVLine(x, 38, 4, SSD1306_WHITE);
    for (uint8_t x = 24; x < 108; x += 8) display.drawPixel(x, 56, SSD1306_WHITE);
    // lilin
    display.fillRect(62, 24, 4, 14, SSD1306_WHITE);
    drawFlame(64, 19);
  } else {
    // lilin + tulisan
    display.fillRect(22, 30, 6, 30, SSD1306_WHITE);
    display.drawFastHLine(12, 62, 26, SSD1306_WHITE);
    drawFlame(25, 25);
    display.setTextSize(2);
    display.setCursor(52, 16); display.print(F("Blow"));
    display.setCursor(52, 36); display.print(F("Again"));
  }
  if (progress > 0) {  // bar progres tiupan di atas
    display.drawRect(0, 0, SCREEN_W, 4, SSD1306_WHITE);
    display.fillRect(0, 0, (uint16_t)SCREEN_W * progress / 100, 4, SSD1306_WHITE);
  }
  display.display();
}

void showTooShort() {
  display.clearDisplay();
  display.setTextSize(1);
  display.setTextColor(SSD1306_WHITE);
  display.setCursor(25, 22); display.print(F("Blow"));
  display.setCursor(43, 34); display.print(F("Longer"));
  display.display();
  wrongSound();

  delay(1500);
}

void wrongSound() {
  tone(PIN_BUZZER, 440, 200);      // "Tet"  : nada lebih tinggi, pendek
  delay(250);
  tone(PIN_BUZZER, 220, 400);      // "Tot"  : nada lebih rendah, lebih panjang
  delay(450);
  noTone(PIN_BUZZER);
}

// ---------- Tunggu tiupan >= 3 detik ----------
void waitForLongBlow(uint8_t phase) {
  digitalWrite(PIN_LED, HIGH);
  bool blowing = false;
  unsigned long start = 0, lastHigh = 0, lastDraw = 0;
  drawScene(phase, 0);

  while (true) {
    unsigned long now = millis();
    if (digitalRead(PIN_SENSOR) == HIGH) {
      if (!blowing) { blowing = true; start = now; }
      lastHigh = now;
    }
    if (blowing) {
      if (now - lastHigh > BLOW_GAP_MS) {      // tiupan berhenti, terlalu pendek
        showTooShort();
        blowing = false;
        drawScene(phase, 0);
      } else if (now - start >= BLOW_TARGET_MS) {
        return;                                // berhasil
      }
    }
    if (now - lastDraw > 90) {
      lastDraw = now;
      uint8_t p = blowing ? (uint8_t)min(100UL, (now - start) * 100UL / BLOW_TARGET_MS) : 0;
      drawScene(phase, p);
    }
  }
}

// ---------- Lagu + confetti ----------
void playBirthdaySong() {
  initConfetti();
  for (uint8_t i = 0; i < NOTE_COUNT; i++) {
    uint16_t f = pgm_read_word(&melody[i]);
    uint16_t d = pgm_read_byte(&beats[i]) * UNIT_MS;
    tone(PIN_BUZZER, f, d * 9 / 10);
    unsigned long t0 = millis();
    while (millis() - t0 < d) {
      drawConfettiFrame();
      delay(30);
    }
  }
  noTone(PIN_BUZZER);
}

void setup() {
  pinMode(PIN_SENSOR, INPUT);
  pinMode(PIN_LED, OUTPUT);
  pinMode(PIN_BUZZER, OUTPUT);
  pinMode(PIN_ISD, OUTPUT);
  pinMode(PIN_BUZZER, OUTPUT);
  digitalWrite(PIN_ISD, LOW);
  randomSeed(analogRead(A0));

  if (!display.begin(SSD1306_SWITCHCAPVCC, OLED_ADDR)) {
    for (;;) { digitalWrite(PIN_LED, !digitalRead(PIN_LED)); delay(150); }  // OLED tidak terdeteksi
  }
  display.clearDisplay();
  display.display();
}

void loop() {
  // Phase 1
  waitForLongBlow(1);
  digitalWrite(PIN_LED, LOW);
  playBirthdaySong();

  // Phase 2
  waitForLongBlow(2);
  digitalWrite(PIN_LED, LOW);
  display.clearDisplay();
  display.drawBitmap(0, 0, surprise_bmp, SCREEN_W, SCREEN_H, SSD1306_WHITE);
  display.display();
  digitalWrite(PIN_ISD, HIGH);       // PLAYL: suara main selama HIGH
  delay(ISD_PLAY_MS);
  digitalWrite(PIN_ISD, LOW);

  // Selesai: tahan gambar sampai Arduino di-reset / dimatikan
  while (true) { delay(1000); }
}
